/*
*********************************************************************************************************
*                                      OPERATING SYSTEM PACKAGE
*
* Name    : 系统计时器
* Version : V1.0
* Author  : 空格键
* ----------------------------
* Note(s) : 使用T0定时器，1ms产生一个中断。使用无符号32位计时，最大可以可运行45.7天溢出。
* Tip(s)  : 如果要提高时间精度，或者增大运行天数，可使用结构体，{中断计数，计数溢出计数}
*********************************************************************************************************
*/

#include "os_timer.h"



/*
*********************************************************************************************************
*                                               DEFINE
*********************************************************************************************************
*/

#define T_1MS (65536-SYSclk/1000)   //1ms timer 重载值
#define T_1US_CNT (SYSclk/1000000)  //1us所属个数


volatile u32 data os_tick;  //系统计时器，无符号32位(4字节)
volatile bit data os_start_enable; //启动标识
volatile u8 data os_time;

u8 xdata origin_sp; //原始栈指针



/*
*********************************************************************************************************
*                                             INTERRUPT
*********************************************************************************************************
*/

/*T0中断服务程序*/ //TODO后面用ASM实现
void T0_ISR() interrupt 1
{
    //==压栈==
    //记录当前任务栈顶
    if (running_task != NULL)
        running_task->stack->sp = (uint8_t idata *)SP;

    SP = origin_sp; //这里使用原始栈，为了不破快任务栈
    os_tick++;      //tick自增

    //任务调度切换
    if (os_start_enable)
    {
        os_time--;
        if (os_time == 0)
        {
            os_time = OS_TIME;
            OS_Task_SW();
        }
    }
    //SP还原/切换
    if (running_task != NULL)
    {
        running_task->timer++;
        origin_sp = SP;
        SP = running_task->stack->sp;
    }
    //==弹栈==
}

/*
*********************************************************************************************************
* Description : 系统计时器初始化
*
* Caller(s)   : OS_Init()
*
* Note(s)     : none.
*********************************************************************************************************
*/
void OS_TIMER_Init(void) large
{
    os_tick = 0ul;
    os_time = OS_TIME;

    AUXR |= 0x80;   //定时器0为1T模式
    TMOD &= ~0x0F;  //定时器0模式0：16位自动重载
    TL0 = T_1MS;     
    TH0 = T_1MS >> 8;
    // ET0 = 1;        //使能定时器中断
    EA = 1;         //开总中断
    
    // TR0 = 1;        //启动定时器
}

/*
*********************************************************************************************************
* Description : 获取系统计时器微秒数
*
* Return(s)   : 返回计时器微秒部分，取值[0,999]
*
* Note(s)     : none.
*********************************************************************************************************
*/
u16 OS_TIMER_GetUs(void)
{
    u16 idata tmp1 = T_1MS, tmp2 = T_1US_CNT;
    return ((TH0 << 8 | TL0) - tmp1) / tmp2;
}

/**********************************************END******************************************************/
